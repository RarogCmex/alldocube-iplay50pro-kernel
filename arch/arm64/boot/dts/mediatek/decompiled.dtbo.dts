/dts-v1/;

/ {

	fragment@0 {
		target = <0xffffffff>;

		__overlay__ {

			cam0@0 {
				phandle = <0x03>;

				pins_cmd_dat {
					pinmux = <0x1400>;
					slew-rate = <0x01>;
					output-low;
				};
			};

			cam0@1 {
				phandle = <0x02>;

				pins_cmd_dat {
					pinmux = <0x1400>;
					slew-rate = <0x01>;
					output-high;
				};
			};

			pnd0@0 {
				phandle = <0x05>;

				pins_cmd_dat {
					pinmux = <0x1500>;
					slew-rate = <0x01>;
					output-low;
				};
			};

			pnd0@1 {
				phandle = <0x04>;

				pins_cmd_dat {
					pinmux = <0x1500>;
					slew-rate = <0x01>;
					output-high;
				};
			};

			cam1@0 {
				phandle = <0x07>;

				pins_cmd_dat {
					pinmux = <0x1000>;
					slew-rate = <0x01>;
					output-low;
				};
			};

			cam1@1 {
				phandle = <0x06>;

				pins_cmd_dat {
					pinmux = <0x1000>;
					slew-rate = <0x01>;
					output-high;
				};
			};

			pnd1@0 {
				phandle = <0x09>;

				pins_cmd_dat {
					pinmux = <0xf00>;
					slew-rate = <0x01>;
					output-low;
				};
			};

			pnd1@1 {
				phandle = <0x08>;

				pins_cmd_dat {
					pinmux = <0xf00>;
					slew-rate = <0x01>;
					output-high;
				};
			};

			camera_pins_cam0_mclk_off {
				phandle = <0x1a>;

				pins_cmd_dat {
					pinmux = <0x8000>;
					drive-strength = <0x01>;
				};
			};

			camera_pins_cam0_mclk_2ma {
				phandle = <0x1b>;

				pins_cmd_dat {
					pinmux = <0x8001>;
					drive-strength = <0x00>;
				};
			};

			camera_pins_cam0_mclk_4ma {
				phandle = <0x1c>;

				pins_cmd_dat {
					pinmux = <0x8001>;
					drive-strength = <0x01>;
				};
			};

			camera_pins_cam0_mclk_6ma {
				phandle = <0x1d>;

				pins_cmd_dat {
					pinmux = <0x8001>;
					drive-strength = <0x02>;
				};
			};

			camera_pins_cam0_mclk_8ma {
				phandle = <0x1e>;

				pins_cmd_dat {
					pinmux = <0x8001>;
					drive-strength = <0x03>;
				};
			};

			camera_pins_cam1_mclk_off {
				phandle = <0x1f>;

				pins_cmd_dat {
					pinmux = <0x7e00>;
					drive-strength = <0x01>;
				};
			};

			camera_pins_cam1_mclk_2ma {
				phandle = <0x20>;

				pins_cmd_dat {
					pinmux = <0x7e01>;
					drive-strength = <0x00>;
				};
			};

			camera_pins_cam1_mclk_4ma {
				phandle = <0x21>;

				pins_cmd_dat {
					pinmux = <0x7e01>;
					drive-strength = <0x01>;
				};
			};

			camera_pins_cam1_mclk_6ma {
				phandle = <0x22>;

				pins_cmd_dat {
					pinmux = <0x7e01>;
					drive-strength = <0x02>;
				};
			};

			camera_pins_cam1_mclk_8ma {
				phandle = <0x23>;

				pins_cmd_dat {
					pinmux = <0x7e01>;
					drive-strength = <0x03>;
				};
			};

			vcama0@0 {
				phandle = <0x0b>;

				pins_cmd_dat {
					pinmux = <0x2c00>;
					slew-rate = <0x01>;
					output-low;
				};
			};

			vcama0@1 {
				phandle = <0x0a>;

				pins_cmd_dat {
					pinmux = <0x2c00>;
					slew-rate = <0x01>;
					output-high;
				};
			};

			vcamd0@0 {
				phandle = <0x0d>;

				pins_cmd_dat {
					pinmux = <0x2d00>;
					slew-rate = <0x01>;
					output-low;
				};
			};

			vcamd0@1 {
				phandle = <0x0c>;

				pins_cmd_dat {
					pinmux = <0x2d00>;
					slew-rate = <0x01>;
					output-high;
				};
			};

			vcamio0@0 {
				phandle = <0x0f>;

				pins_cmd_dat {
					pinmux = <0x2b00>;
					slew-rate = <0x01>;
					output-low;
				};
			};

			vcamio0@1 {
				phandle = <0x0e>;

				pins_cmd_dat {
					pinmux = <0x2b00>;
					slew-rate = <0x01>;
					output-high;
				};
			};

			afen0@0 {
				phandle = <0x11>;

				pins_cmd_dat {
					pinmux = <0x9e00>;
					slew-rate = <0x01>;
					output-low;
				};
			};

			afen0@1 {
				phandle = <0x10>;

				pins_cmd_dat {
					pinmux = <0x9e00>;
					slew-rate = <0x01>;
					output-high;
				};
			};

			vcama1@0 {
				phandle = <0x13>;

				pins_cmd_dat {
					pinmux = <0x2c00>;
					slew-rate = <0x01>;
					output-low;
				};
			};

			vcama1@1 {
				phandle = <0x12>;

				pins_cmd_dat {
					pinmux = <0x2c00>;
					slew-rate = <0x01>;
					output-high;
				};
			};

			vcamd1@0 {
				phandle = <0x15>;

				pins_cmd_dat {
					pinmux = <0x2d00>;
					slew-rate = <0x01>;
					output-low;
				};
			};

			vcamd1@1 {
				phandle = <0x14>;

				pins_cmd_dat {
					pinmux = <0x2d00>;
					slew-rate = <0x01>;
					output-high;
				};
			};

			vcamio1@0 {
				phandle = <0x17>;

				pins_cmd_dat {
					pinmux = <0x2b00>;
					slew-rate = <0x01>;
					output-low;
				};
			};

			vcamio1@1 {
				phandle = <0x16>;

				pins_cmd_dat {
					pinmux = <0x2b00>;
					slew-rate = <0x01>;
					output-high;
				};
			};

			afen1@0 {
				phandle = <0x19>;

				pins_cmd_dat {
					pinmux = <0x9e00>;
					slew-rate = <0x01>;
					output-low;
				};
			};

			afen1@1 {
				phandle = <0x18>;

				pins_cmd_dat {
					pinmux = <0x9e00>;
					slew-rate = <0x01>;
					output-high;
				};
			};

			camdefault {
				phandle = <0x01>;
			};
		};
	};

	fragment@1 {
		target = <0xffffffff>;

		__overlay__ {
			pinctrl-names = "default\0cam0_rst1\0cam0_rst0\0cam0_pnd1\0cam0_pnd0\0cam1_rst1\0cam1_rst0\0cam1_pnd1\0cam1_pnd0\0cam0_ldo_vcama_1\0cam0_ldo_vcama_0\0cam0_ldo_vcamd_1\0cam0_ldo_vcamd_0\0cam0_ldo_vcamio_1\0cam0_ldo_vcamio_0\0cam0_ldo_afen_1\0cam0_ldo_afen_0\0cam1_ldo_vcama_1\0cam1_ldo_vcama_0\0cam1_ldo_vcamd_1\0cam1_ldo_vcamd_0\0cam1_ldo_vcamio_1\0cam1_ldo_vcamio_0\0cam1_ldo_afen_1\0cam1_ldo_afen_0\0cam0_mclk_off\0cam0_mclk_2mA\0cam0_mclk_4mA\0cam0_mclk_6mA\0cam0_mclk_8mA\0cam1_mclk_off\0cam1_mclk_2mA\0cam1_mclk_4mA\0cam1_mclk_6mA\0cam1_mclk_8mA";
			pinctrl-0 = <0x01>;
			pinctrl-1 = <0x02>;
			pinctrl-2 = <0x03>;
			pinctrl-3 = <0x04>;
			pinctrl-4 = <0x05>;
			pinctrl-5 = <0x06>;
			pinctrl-6 = <0x07>;
			pinctrl-7 = <0x08>;
			pinctrl-8 = <0x09>;
			pinctrl-9 = <0x0a>;
			pinctrl-10 = <0x0b>;
			pinctrl-11 = <0x0c>;
			pinctrl-12 = <0x0d>;
			pinctrl-13 = <0x0e>;
			pinctrl-14 = <0x0f>;
			pinctrl-15 = <0x10>;
			pinctrl-16 = <0x11>;
			pinctrl-17 = <0x12>;
			pinctrl-18 = <0x13>;
			pinctrl-19 = <0x14>;
			pinctrl-20 = <0x15>;
			pinctrl-21 = <0x16>;
			pinctrl-22 = <0x17>;
			pinctrl-23 = <0x18>;
			pinctrl-24 = <0x19>;
			pinctrl-25 = <0x1a>;
			pinctrl-26 = <0x1b>;
			pinctrl-27 = <0x1c>;
			pinctrl-28 = <0x1d>;
			pinctrl-29 = <0x1e>;
			pinctrl-30 = <0x1f>;
			pinctrl-31 = <0x20>;
			pinctrl-32 = <0x21>;
			pinctrl-33 = <0x22>;
			pinctrl-34 = <0x23>;
			cam0_pin_mclk = "mclk";
			cam0_pin_rst = "gpio";
			cam0_pin_pdn = "gpio";
			cam0_pin_vcama = "gpio";
			cam0_pin_vcamio = "gpio";
			cam0_pin_vcamd = "gpio";
			cam0_pin_vcamaf = "gpio";
			cam1_pin_mclk = "mclk";
			cam1_pin_rst = "gpio";
			cam1_pin_pdn = "gpio";
			cam1_pin_vcama = "gpio";
			cam1_pin_vcamio = "gpio";
			cam1_pin_vcamd = "gpio";
			cam1_pin_mipi_switch_sel = "gpio";
			cam0_enable_sensor = "ov8856_mipi_raw gc8034_mipi_raw s5k3l8_mipi_raw gc13a0_mipi_raw s5k4h5yc_mipi_raw";
			cam1_enable_sensor = "sc500cs_mipi_raw gc05a2_mipi_raw";
			status = "okay";
		};
	};

	fragment@2 {
		target = <0xffffffff>;

		__overlay__ {
			status = "okay";
			clock-frequency = <0x61a80>;
			#address-cells = <0x01>;
			#size-cells = <0x00>;

			camera_eeprom2@51 {
				compatible = "mediatek,camera_eeprom";
				reg = <0x51>;
				status = "okay";
				phandle = <0x3f>;
			};

			camera_main_two@10 {
				compatible = "mediatek,camera_main_two";
				#thermal-sensor-cells = <0x00>;
				reg = <0x10>;
				status = "okay";
				phandle = <0x26>;
			};
		};
	};

	fragment@3 {
		target = <0xffffffff>;

		__overlay__ {
			status = "okay";
			clock-frequency = <0x61a80>;
			#address-cells = <0x01>;
			#size-cells = <0x00>;

			camera_eeprom1@51 {
				compatible = "mediatek,camera_eeprom";
				reg = <0x51>;
				status = "okay";
				phandle = <0x40>;
			};

			camera_sub@1a {
				compatible = "mediatek,camera_sub";
				#thermal-sensor-cells = <0x00>;
				reg = <0x1a>;
				status = "okay";
				phandle = <0x25>;
			};

			camera_eeprom3@52 {
				compatible = "mediatek,camera_eeprom";
				reg = <0x52>;
				status = "okay";
				phandle = <0x41>;
			};

			camera_sub_two@10 {
				compatible = "mediatek,camera_sub_two";
				#thermal-sensor-cells = <0x00>;
				reg = <0x10>;
				status = "okay";
				phandle = <0x42>;
			};
		};
	};

	fragment@4 {
		target = <0xffffffff>;

		__overlay__ {
			status = "okay";
			clock-frequency = <0x61a80>;
			#address-cells = <0x01>;
			#size-cells = <0x00>;

			camera_eeprom0@50 {
				compatible = "mediatek,camera_eeprom";
				reg = <0x50>;
				status = "okay";
				phandle = <0x43>;
			};

			camera_main@1a {
				compatible = "mediatek,camera_main";
				#thermal-sensor-cells = <0x00>;
				reg = <0x1a>;
				status = "okay";
				phandle = <0x24>;
			};
		};
	};

	fragment@5 {
		target = <0xffffffff>;

		__overlay__ {

			camera_main {
				polling-delay = <0x3e8>;
				polling-delay-passive = <0x00>;
				thermal-sensors = <0x24>;
				phandle = <0x44>;
			};

			camera_sub {
				polling-delay = <0x3e8>;
				polling-delay-passive = <0x00>;
				thermal-sensors = <0x25>;
				phandle = <0x45>;
			};

			camera_main_two {
				polling-delay = <0x3e8>;
				polling-delay-passive = <0x00>;
				thermal-sensors = <0x26>;
				phandle = <0x46>;
			};
		};
	};

	fragment@6 {
		target = <0xffffffff>;

		__overlay__ {
		};
	};

	fragment@7 {
		target = <0xffffffff>;

		__overlay__ {
			compatible = "mediatek,pwm-leds";

			backlight {
				label = "lcd-backlight";
				max-brightness = <0xff>;
				max-hw-brightness = <0x3ff>;
				led_mode = <0x05>;
				gate_enable = <0x00>;
				pwm_config = <0x00 0x01 0x00 0x00 0x00>;
				pwms = <0xffffffff 0x00 0x99d9>;
				pwm-names = "lcd-backlight";
			};
		};
	};

	fragment@8 {
		target = <0xffffffff>;

		__overlay__ {
			microtrust,real-drv = <0x01>;
		};
	};

	fragment@9 {
		target = <0xffffffff>;

		__overlay__ {

			lcm_led_en1_gpio {
				phandle = <0x27>;

				pins_cmd_dat {
					pinmux = <0x9700>;
					slew-rate = <0x01>;
					output-high;
				};
			};

			lcm_led_en0_gpio {
				phandle = <0x28>;

				pins_cmd_dat {
					pinmux = <0x9700>;
					slew-rate = <0x01>;
					output-low;
				};
			};

			lcm_3v3_en1_gpio {
				phandle = <0x29>;

				pins_cmd_dat {
					pinmux = <0x9c00>;
					slew-rate = <0x01>;
					output-high;
				};
			};

			lcm_3v3_en0_gpio {
				phandle = <0x2a>;

				pins_cmd_dat {
					pinmux = <0x9c00>;
					slew-rate = <0x01>;
					output-low;
				};
			};

			lcm_rst_out1_gpio {
				phandle = <0x2b>;

				pins_cmd_dat {
					pinmux = <0x5500>;
					slew-rate = <0x01>;
					output-high;
				};
			};

			lcm_rst_out0_gpio {
				phandle = <0x2c>;

				pins_cmd_dat {
					pinmux = <0x5500>;
					slew-rate = <0x01>;
					output-low;
				};
			};

			lcm_dsi_te {
				phandle = <0x2d>;

				pins_cmd_dat {
					pinmux = <0x5301>;
				};
			};

			lcd_bias_enp1_gpio {
				phandle = <0x2e>;

				pins_cmd_dat {
					pinmux = <0x2300>;
					slew-rate = <0x01>;
					output-high;
				};
			};

			lcd_bias_enp0_gpio {
				phandle = <0x2f>;

				pins_cmd_dat {
					pinmux = <0x2300>;
					slew-rate = <0x01>;
					output-low;
				};
			};

			lcd_bias_enn1_gpio {
				phandle = <0x30>;

				pins_cmd_dat {
					pinmux = <0x2200>;
					slew-rate = <0x01>;
					output-high;
				};
			};

			lcd_bias_enn0_gpio {
				phandle = <0x31>;

				pins_cmd_dat {
					pinmux = <0x2200>;
					slew-rate = <0x01>;
					output-low;
				};
			};
		};
	};

	fragment@10 {
		target = <0xffffffff>;

		__overlay__ {
			pinctrl-names = "lcm_led_en1_gpio\0lcm_led_en0_gpio\0lcm_3v3_en1_gpio\0lcm_3v3_en0_gpio\0lcm_rst_out1_gpio\0lcm_rst_out0_gpio\0mode_te_te\0lcd_bias_enp1_gpio\0lcd_bias_enp0_gpio\0lcd_bias_enn1_gpio\0lcd_bias_enn0_gpio";
			pinctrl-0 = <0x27>;
			pinctrl-1 = <0x28>;
			pinctrl-2 = <0x29>;
			pinctrl-3 = <0x2a>;
			pinctrl-4 = <0x2b>;
			pinctrl-5 = <0x2c>;
			pinctrl-6 = <0x2d>;
			pinctrl-7 = <0x2e>;
			pinctrl-8 = <0x2f>;
			pinctrl-9 = <0x30>;
			pinctrl-10 = <0x31>;
			status = "okay";
		};
	};

	fragment@11 {
		target = <0xffffffff>;

		__overlay__ {
			pinctrl-names = "lcm_rst_out1_gpio\0lcm_rst_out0_gpio\0mode_te_te";
			pinctrl-0 = <0x2b>;
			pinctrl-1 = <0x2c>;
			pinctrl-2 = <0x2d>;
			status = "okay";
		};
	};

	fragment@12 {
		target = <0xffffffff>;

		__overlay__ {
			status = "okay";
			#address-cells = <0x01>;
			#size-cells = <0x00>;

			panel1 {
				compatible = "boe,hx83102e,vdo";
				reg = <0x00>;
				_1v8-gpios = <0xffffffff 0x97 0x00>;
				_3v3-gpios = <0xffffffff 0x9c 0x00>;
				reset-gpios = <0xffffffff 0x55 0x00>;
				bias-gpios = <0xffffffff 0x23 0x00 0xffffffff 0x22 0x00>;
				pinctrl-names = "default";

				port {

					endpoint {
						remote-endpoint = <0x32>;
						phandle = <0x33>;
					};
				};
			};

			panel2 {
				compatible = "boe,hx83102e,spi";
				reg = <0x01>;
				_1v8-gpios = <0xffffffff 0x97 0x00>;
				_3v3-gpios = <0xffffffff 0x9c 0x00>;
				reset-gpios = <0xffffffff 0x55 0x00>;
				bias-gpios = <0xffffffff 0x23 0x00 0xffffffff 0x22 0x00>;
				pinctrl-names = "default";

				port {

					endpoint {
						remote-endpoint = <0x32>;
						phandle = <0x47>;
					};
				};
			};

			panel3 {
				compatible = "novatek,nt36523,vdo";
				reg = <0x02>;
				_1v8-gpios = <0xffffffff 0x97 0x00>;
				_3v3-gpios = <0xffffffff 0x9c 0x00>;
				reset-gpios = <0xffffffff 0x55 0x00>;
				bias-gpios = <0xffffffff 0x23 0x00 0xffffffff 0x22 0x00>;
				pinctrl-names = "default";

				port {

					endpoint {
						remote-endpoint = <0x32>;
						phandle = <0x48>;
					};
				};
			};

			ports {

				port {

					endpoint {
						remote-endpoint = <0x33>;
						phandle = <0x32>;
					};
				};
			};
		};
	};

	fragment@13 {
		target = <0xffffffff>;

		__overlay__ {

			gps_default {
				phandle = <0x34>;
			};

			gps_l1_lna@0 {
				phandle = <0x35>;

				pins_cmd_dat {
					pinmux = <0x1900>;
					output-low;
				};
			};

			gps_l1_lna@1 {
				phandle = <0x36>;

				pins_cmd_dat {
					pinmux = <0x1902>;
				};
			};

			gps_l1_lna@2 {
				phandle = <0x37>;

				pins_cmd_dat {
					pinmux = <0x1900>;
					output-high;
				};
			};
		};
	};

	fragment@14 {
		target = <0xffffffff>;

		__overlay__ {
			pinctrl-names = "default\0gps_l1_lna_disable\0gps_l1_lna_dsp_ctrl\0gps_l1_lna_enable\0gps_l5_lna_disable\0gps_l5_lna_dsp_ctrl\0gps_l5_lna_enable";
			pinctrl-0 = <0x34>;
			pinctrl-1 = <0x35>;
			pinctrl-2 = <0x36>;
			pinctrl-3 = <0x37>;
			status = "okay";
		};
	};

	fragment@15 {
		target = <0xffffffff>;

		__overlay__ {
			status = "okay";
			clock-frequency = <0x61a80>;
			#address-cells = <0x01>;
			#size-cells = <0x00>;

			himax_touch@48 {
				compatible = "himax,hxcommon";
				reg = <0x48>;
				interrupt-parent = <0xffffffff>;
				himax,irq-gpio = <0xffffffff 0x09 0x00>;
				himax,rst-gpio = <0xffffffff 0x98 0x00>;
				himax,3v3-gpio = <0xffffffff 0x6d 0x00>;
				himax,panel-coords = <0x00 0x4b0 0x00 0x7d0>;
				himax,display-coords = <0x4b0 0x7d0>;
				report_type = <0x01>;
			};
		};
	};

	fragment@16 {
		target = <0xffffffff>;

		__overlay__ {
			status = "okay";
			#address-cells = <0x01>;
			#size-cells = <0x00>;
			spi-max-frequency = <0x989680>;

			spi-himax@0 {
				compatible = "himax,hxcommonspi";
				spi-max-frequency = <0x989680>;
				reg = <0x00>;
				status = "ok";
				himax,panel-coords = <0x00 0x4b0 0x00 0x7d0>;
				himax,display-coords = <0x00 0x4b0 0x00 0x7d0>;
				himax,rst-gpio = <0xffffffff 0x98 0x00>;
				himax,irq-gpio = <0xffffffff 0x09 0x00>;
				himax,lcm-id0 = <0xffffffff 0x57 0x00>;
				himax,lcm-id1 = <0xffffffff 0x5d 0x00>;
			};

			spi-touch@1 {
				compatible = "novatek,NVT-ts-spi";
				reg = <0x01>;
				spi-max-frequency = <0x989680>;
				novatek,reset-gpio = <0xffffffff 0x98 0x00>;
				novatek,irq-gpio = <0xffffffff 0x09 0x00>;
				novatek,swrst-n8-addr = <0x3f0fe>;
				novatek,spi-rd-fast-addr = <0x3f310>;
				pinctrl-names = "novatek_default\0novatek_power_on\0novatek_power_off";
				pinctrl-0 = <0x38>;
				pinctrl-1 = <0x39>;
				pinctrl-2 = <0x3a>;
			};
		};
	};

	fragment@17 {
		target = <0xffffffff>;

		__overlay__ {

			ctp_novatek_pins_novatek_default {
				phandle = <0x38>;
			};

			ctp_novatek_pins_novatek_power_on {
				phandle = <0x39>;

				pins_cmd0_dat {
					pinmux = <0x1f01>;
				};

				pins_cmd1_dat {
					pinmux = <0x900>;
					slew-rate = <0x00>;
					input-enable;
				};
			};

			ctp_novatek_pins_novatek_power_off {
				phandle = <0x3a>;

				pins_cmd0_dat {
					pinmux = <0x1f00>;
					slew-rate = <0x01>;
					output-low;
				};

				pins_cmd1_dat {
					pinmux = <0x900>;
					slew-rate = <0x01>;
					output-low;
				};
			};
		};
	};

	fragment@18 {
		target = <0xffffffff>;

		__overlay__ {

			camera_main_af@72 {
				compatible = "mediatek,camera_main_af";
				reg = <0x72>;
				status = "okay";
				phandle = <0x49>;
			};
		};
	};

	fragment@19 {
		target = <0xffffffff>;

		__overlay__ {

			camera_main_two_af@0d {
				compatible = "mediatek,camera_main_two_af";
				reg = <0x0d>;
				status = "okay";
				phandle = <0x4a>;
			};

			camera_main_three_af@0c {
				compatible = "mediatek,camera_main_three_af";
				reg = <0x0c>;
				status = "okay";
				phandle = <0x4b>;
			};
		};
	};

	fragment@20 {
		target = <0xffffffff>;

		__overlay__ {
			status = "okay";
		};
	};

	fragment@21 {
		target = <0xffffffff>;

		__overlay__ {
			clock-frequency = <0x186a0>;

			wusb3801x@60 {
				compatible = "mediatek,wusb3801x";
				reg = <0x60>;
				status = "okay";
			};
		};
	};

	fragment@22 {
		target = <0xffffffff>;

		__overlay__ {

			speaker_amp@35 {
				compatible = "awinic,aw881xx_smartpa";
				#sound-dai-cells = <0x00>;
				reg = <0x35>;
				reset-gpio = <0xffffffff 0x30 0x00>;
				irq-gpio = <0xffffffff 0x31 0x00>;
				fade-enable = <0x00>;
				sound-channel = <0x00>;
				pa-syn-enable = <0x00>;
				status = "okay";
				sound-name-prefix = "Left";
				phandle = <0x3b>;
			};

			speaker_amp@34 {
				compatible = "awinic,aw881xx_smartpa";
				#sound-dai-cells = <0x00>;
				reg = <0x34>;
				reset-gpio = <0xffffffff 0x2f 0x00>;
				irq-gpio = <0xffffffff 0x2e 0x00>;
				fade-enable = <0x00>;
				sound-channel = <0x01>;
				pa-syn-enable = <0x00>;
				status = "okay";
				sound-name-prefix = "Right";
				phandle = <0x3c>;
			};
		};
	};

	fragment@23 {
		target = <0xffffffff>;

		__overlay__ {
			mediatek,spk-i2s = <0x03 0x00>;

			mediatek,speaker-codec {
				sound-dai = <0x3b 0x3c>;
			};
		};
	};

	fragment@24 {
		target = <0xffffffff>;

		__overlay__ {

			mt6366-charger-type {
				compatible = "mediatek,mt6366-charger-type";
				io-channels = <0xffffffff 0x02>;
				io-channel-names = "pmic_vbus_voltage";
				status = "okay";
				phandle = <0x3e>;
			};
		};
	};

	fragment@25 {
		target = <0xffffffff>;

		__overlay__ {
			clock-frequency = <0x186a0>;

			sgm41512_main@1a {
				compatible = "sgm,sgm41512";
				reg = <0x1a>;
				status = "okay";
				sgm,irq-gpio = <0xffffffff 0x04 0x00>;
				sgm,chg-en-gpio = <0xffffffff 0x01 0x00>;
				chg_name = "primary_chg";
				input-current-limit-microamp = <0x1f47d0>;
				phandle = <0x4c>;

				usb-otg-vbus {
					regulator-compatible = "usb-otg-vbus";
					regulator-name = "usb-otg-vbus";
					phandle = <0x3d>;
				};
			};
		};
	};

	fragment@26 {
		target = <0xffffffff>;

		__overlay__ {
			clock-frequency = <0x186a0>;

			sgm41513_sub@1a {
				compatible = "sgm,sgm41513";
				reg = <0x1a>;
				status = "okay";
				sgm,irq-gpio = <0xffffffff 0x05 0x00>;
				sgm,chg-en-gpio = <0xffffffff 0x9d 0x00>;
				charger_name = "secondary_chg";
				phandle = <0x4d>;
			};
		};
	};

	fragment@27 {
		target = <0xffffffff>;

		__overlay__ {
			vbus-supply = <0x3d>;
			vbus-voltage = <0x00>;
			vbus-current = <0x00>;
			charger = <0x3e>;
		};
	};

	fragment@28 {
		target = <0xffffffff>;

		__overlay__ {
			charger = <0x3e>;
			fast_charging_indicator = <0x01>;
			algorithm_name = "Basic";
			charger_configuration = <0x01>;
			battery_cv = <0x426030>;
			ac_charger_current = <0x1f47d0>;
			ac_charger_input_current = <0x1f47d0>;
		};
	};

	fragment@29 {
		target = <0xffffffff>;

		__overlay__ {
			charger = <0x3e>;
		};
	};

	fragment@30 {
		target = <0xffffffff>;

		__overlay__ {
			ta_ac_9v_input_current = <0x1e8480>;
			ta_ac_7v_input_current = <0x1e8480>;
			pe_charger_current = <0x3567e0>;
			dual_polling_ieoc = <0x6ddd0>;
			slave_mivr_diff = <0x186a0>;
		};
	};

	fragment@31 {
		target = <0xffffffff>;

		__overlay__ {
			dcs_input_current = <0x30d400>;
			dcs_chg1_charger_current = <0x1b7740>;
			dcs_chg2_charger_current = <0x1b7740>;
		};
	};

	fragment@32 {
		target = <0xffffffff>;

		__overlay__ {
			pd_vbus_upper_bound = <0xb71b00>;
		};
	};

	fragment@33 {
		target = <0xffffffff>;

		__overlay__ {
			status = "disabled";
		};
	};

	fragment@34 {
		target = <0xffffffff>;

		__overlay__ {
			status = "disabled";
		};
	};

	fragment@35 {
		target = <0xffffffff>;

		__overlay__ {
			status = "disabled";
		};
	};

	fragment@36 {
		target = <0xffffffff>;

		__overlay__ {
			status = "disabled";
		};
	};

	fragment@37 {
		target = <0xffffffff>;

		__overlay__ {
			GPIO_SIM1_HOT_PLUG = <0xffffffff 0x17 0x00>;
			GPIO_SIM2_HOT_PLUG = <0xffffffff 0x18 0x00>;
			GPIO_SIM1_SCLK = <0xffffffff 0x4d 0x00>;
			GPIO_SIM1_SRST = <0xffffffff 0x4e 0x00>;
			GPIO_SIM1_SIO = <0xffffffff 0x4f 0x00>;
			GPIO_SIM2_SCLK = <0xffffffff 0x50 0x00>;
			GPIO_SIM2_SRST = <0xffffffff 0x51 0x00>;
			GPIO_SIM2_SIO = <0xffffffff 0x52 0x00>;
			GPIO_FDD_BAND_SUPPORT_DETECT_1ST_PIN = <0xffffffff 0x6f 0x00>;
		};
	};

	fragment@38 {
		target = <0xffffffff>;

		__overlay__ {
			gpio_init_default = <0x00 0x00 0x00 0x00 0x01 0x01 0x01 0x01 0x00 0x01 0x00 0x01 0x00 0x01 0x02 0x00 0x00 0x00 0x01 0x00 0x01 0x03 0x01 0x00 0x00 0x01 0x00 0x01 0x04 0x00 0x00 0x00 0x01 0x01 0x01 0x05 0x00 0x00 0x00 0x01 0x01 0x01 0x06 0x00 0x00 0x00 0x01 0x01 0x01 0x07 0x00 0x00 0x00 0x01 0x01 0x01 0x08 0x00 0x00 0x00 0x01 0x00 0x01 0x09 0x00 0x00 0x00 0x01 0x01 0x01 0x0a 0x00 0x00 0x00 0x01 0x00 0x01 0x0b 0x00 0x00 0x00 0x01 0x01 0x01 0x0c 0x00 0x00 0x00 0x01 0x00 0x01 0x0d 0x00 0x00 0x00 0x01 0x01 0x01 0x0e 0x00 0x00 0x00 0x01 0x01 0x00 0x0f 0x00 0x01 0x00 0x01 0x00 0x00 0x10 0x00 0x01 0x00 0x01 0x00 0x00 0x11 0x00 0x01 0x00 0x01 0x00 0x00 0x12 0x00 0x01 0x00 0x01 0x00 0x00 0x13 0x00 0x01 0x00 0x01 0x00 0x00 0x14 0x00 0x01 0x00 0x01 0x00 0x00 0x15 0x00 0x01 0x00 0x01 0x00 0x00 0x16 0x00 0x01 0x00 0x01 0x00 0x00 0x17 0x01 0x00 0x00 0x01 0x01 0x00 0x18 0x01 0x00 0x00 0x01 0x01 0x00 0x19 0x02 0x00 0x00 0x01 0x00 0x01 0x1a 0x00 0x01 0x00 0x01 0x00 0x01 0x1b 0x00 0x00 0x00 0x01 0x00 0x00 0x1c 0x01 0x00 0x00 0x01 0x01 0x01 0x1d 0x01 0x00 0x00 0x00 0x00 0x01 0x1e 0x01 0x00 0x00 0x00 0x00 0x01 0x1f 0x01 0x00 0x00 0x00 0x00 0x01 0x20 0x01 0x00 0x00 0x00 0x00 0x01 0x21 0x01 0x00 0x00 0x01 0x00 0x01 0x22 0x00 0x01 0x00 0x01 0x00 0x00 0x23 0x00 0x01 0x00 0x01 0x00 0x00 0x24 0x00 0x01 0x00 0x01 0x00 0x00 0x25 0x00 0x01 0x00 0x01 0x00 0x00 0x26 0x02 0x00 0x00 0x00 0x00 0x01 0x27 0x02 0x00 0x00 0x00 0x00 0x01 0x28 0x02 0x00 0x00 0x00 0x00 0x01 0x29 0x02 0x00 0x00 0x01 0x00 0x01 0x2a 0x00 0x01 0x00 0x01 0x00 0x00 0x2b 0x00 0x01 0x00 0x01 0x00 0x00 0x2c 0x00 0x01 0x00 0x01 0x00 0x00 0x2d 0x00 0x01 0x00 0x01 0x00 0x00 0x2e 0x00 0x00 0x00 0x01 0x01 0x00 0x2f 0x00 0x01 0x00 0x01 0x00 0x00 0x30 0x00 0x01 0x00 0x01 0x00 0x00 0x31 0x00 0x00 0x00 0x01 0x01 0x00 0x32 0x02 0x00 0x00 0x00 0x00 0x01 0x33 0x02 0x00 0x00 0x00 0x00 0x01 0x34 0x02 0x00 0x00 0x00 0x00 0x01 0x35 0x00 0x00 0x00 0x01 0x00 0x01 0x42 0x01 0x00 0x00 0x01 0x01 0x00 0x43 0x01 0x00 0x00 0x01 0x01 0x01 0x44 0x00 0x00 0x00 0x01 0x00 0x01 0x45 0x00 0x00 0x00 0x01 0x01 0x01 0x4d 0x01 0x00 0x00 0x00 0x00 0x01 0x4e 0x01 0x00 0x00 0x00 0x00 0x01 0x4f 0x01 0x00 0x00 0x01 0x01 0x01 0x50 0x01 0x00 0x00 0x00 0x00 0x01 0x51 0x01 0x00 0x00 0x00 0x00 0x01 0x52 0x01 0x00 0x00 0x01 0x01 0x01 0x53 0x01 0x00 0x00 0x01 0x00 0x01 0x54 0x01 0x00 0x00 0x00 0x00 0x01 0x55 0x01 0x00 0x00 0x00 0x00 0x01 0x56 0x01 0x00 0x00 0x01 0x00 0x00 0x57 0x00 0x00 0x00 0x00 0x00 0x00 0x58 0x01 0x00 0x00 0x01 0x00 0x00 0x59 0x01 0x00 0x00 0x01 0x00 0x00 0x5a 0x01 0x00 0x00 0x01 0x00 0x00 0x5b 0x01 0x00 0x00 0x01 0x00 0x00 0x5c 0x01 0x00 0x00 0x01 0x00 0x00 0x5d 0x00 0x00 0x00 0x00 0x00 0x00 0x5e 0x00 0x00 0x00 0x00 0x00 0x00 0x5f 0x01 0x00 0x00 0x01 0x00 0x00 0x60 0x01 0x00 0x00 0x01 0x00 0x00 0x61 0x01 0x00 0x00 0x01 0x00 0x00 0x62 0x01 0x00 0x00 0x01 0x00 0x00 0x63 0x01 0x00 0x00 0x01 0x00 0x00 0x64 0x00 0x00 0x00 0x01 0x00 0x00 0x65 0x00 0x00 0x00 0x01 0x00 0x00 0x66 0x01 0x00 0x00 0x01 0x00 0x00 0x67 0x02 0x00 0x00 0x01 0x00 0x00 0x68 0x02 0x00 0x00 0x00 0x00 0x00 0x69 0x00 0x01 0x00 0x01 0x00 0x00 0x6a 0x01 0x00 0x00 0x01 0x00 0x00 0x6b 0x01 0x00 0x00 0x01 0x00 0x00 0x6c 0x01 0x00 0x00 0x01 0x00 0x00 0x6d 0x00 0x01 0x00 0x01 0x00 0x00 0x6e 0x00 0x01 0x01 0x01 0x00 0x00 0x6f 0x00 0x00 0x00 0x00 0x00 0x00 0x70 0x01 0x00 0x00 0x00 0x00 0x00 0x71 0x01 0x00 0x00 0x01 0x00 0x00 0x72 0x01 0x00 0x00 0x00 0x00 0x00 0x73 0x01 0x00 0x00 0x01 0x00 0x00 0x74 0x01 0x00 0x00 0x00 0x00 0x00 0x75 0x01 0x00 0x00 0x01 0x00 0x00 0x76 0x01 0x00 0x00 0x00 0x00 0x00 0x77 0x01 0x00 0x00 0x01 0x00 0x00 0x78 0x01 0x00 0x00 0x00 0x00 0x00 0x79 0x01 0x00 0x00 0x01 0x00 0x00 0x7a 0x01 0x00 0x00 0x00 0x00 0x00 0x7b 0x01 0x00 0x00 0x00 0x00 0x00 0x7c 0x01 0x00 0x00 0x01 0x00 0x00 0x7d 0x01 0x00 0x00 0x01 0x00 0x00 0x7e 0x01 0x00 0x00 0x01 0x00 0x00 0x7f 0x01 0x00 0x00 0x01 0x00 0x00 0x80 0x01 0x00 0x00 0x01 0x00 0x00 0x81 0x01 0x00 0x00 0x01 0x00 0x00 0x82 0x01 0x00 0x00 0x01 0x01 0x01 0x83 0x01 0x00 0x00 0x01 0x01 0x01 0x84 0x02 0x00 0x00 0x01 0x01 0x00 0x85 0x02 0x00 0x00 0x01 0x01 0x00 0x86 0x01 0x00 0x00 0x01 0x01 0x01 0x87 0x01 0x00 0x00 0x01 0x01 0x01 0x88 0x01 0x00 0x00 0x01 0x01 0x01 0x89 0x01 0x00 0x00 0x01 0x01 0x01 0x8a 0x01 0x00 0x00 0x01 0x01 0x01 0x8b 0x01 0x00 0x00 0x01 0x01 0x01 0x8c 0x01 0x00 0x00 0x01 0x01 0x01 0x8d 0x01 0x00 0x00 0x01 0x01 0x01 0x8e 0x01 0x00 0x00 0x01 0x01 0x01 0x8f 0x01 0x00 0x00 0x01 0x01 0x01 0x90 0x01 0x00 0x00 0x01 0x01 0x01 0x91 0x01 0x00 0x00 0x01 0x01 0x01 0x92 0x01 0x00 0x00 0x01 0x01 0x01 0x93 0x01 0x00 0x00 0x01 0x01 0x01 0x94 0x02 0x00 0x00 0x01 0x01 0x01 0x95 0x02 0x00 0x00 0x01 0x01 0x01 0x96 0x00 0x01 0x00 0x01 0x00 0x01 0x97 0x00 0x01 0x00 0x01 0x00 0x01 0x98 0x00 0x01 0x00 0x01 0x00 0x01 0x99 0x00 0x01 0x00 0x01 0x00 0x01 0x9a 0x00 0x01 0x00 0x01 0x00 0x01 0x9b 0x00 0x01 0x00 0x01 0x00 0x01 0x9c 0x00 0x01 0x00 0x01 0x00 0x01 0x9d 0x00 0x01 0x01 0x01 0x00 0x01 0x9e 0x00 0x01 0x00 0x01 0x00 0x00 0x9f 0x00 0x00 0x00 0x01 0x01 0x00 0xa0 0x01 0x00 0x00 0x00 0x00 0x01 0xa1 0x01 0x00 0x00 0x00 0x00 0x01 0xa2 0x01 0x00 0x00 0x00 0x00 0x01 0xa3 0x01 0x00 0x00 0x01 0x00 0x01 0xa4 0x01 0x00 0x00 0x00 0x00 0x01 0xa5 0x01 0x00 0x00 0x00 0x00 0x01 0xa6 0x01 0x00 0x00 0x00 0x00 0x01 0xa7 0x01 0x00 0x00 0x01 0x00 0x01 0xa8 0x01 0x00 0x00 0x00 0x00 0x00 0xa9 0x01 0x00 0x00 0x00 0x00 0x01 0xaa 0x01 0x00 0x00 0x00 0x00 0x01 0xab 0x01 0x00 0x00 0x00 0x00 0x01 0xac 0x01 0x00 0x00 0x00 0x00 0x01 0xad 0x01 0x00 0x00 0x01 0x00 0x01 0xae 0x01 0x00 0x00 0x01 0x00 0x01 0xaf 0x01 0x00 0x00 0x01 0x00 0x01 0xb0 0x01 0x00 0x00 0x01 0x00 0x01 0xb1 0x00 0x00 0x00 0x01 0x00 0x00 0xb2 0x00 0x00 0x00 0x01 0x00 0x00 0xb3 0x00 0x00 0x00 0x01 0x00 0x00 0xb4 0x00 0x00 0x00 0x01 0x00 0x00 0xb5 0x00 0x00 0x00 0x01 0x00 0x00 0xb6 0x00 0x00 0x00 0x01 0x00 0x00 0xb7 0x00 0x00 0x00 0x01 0x00 0x00 0xb8 0x00 0x00 0x00 0x01 0x00 0x00 0xb9 0x00 0x00 0x00 0x01 0x00 0x00 0xba 0x01 0x00 0x00 0x01 0x01 0x01 0xbb 0x01 0x00 0x00 0x01 0x01 0x01 0xbc 0x00 0x00 0x00 0x01 0x00 0x00 0xbd 0x00 0x00 0x00 0x01 0x00 0x00 0xbe 0x00 0x00 0x00 0x01 0x00 0x00 0xbf 0x00 0x00 0x00 0x01 0x00 0x00 0xc0 0x00 0x00 0x00 0x01 0x00 0x00 0xc1 0x00 0x00 0x00 0x01 0x00 0x00 0xc2 0x00 0x00 0x00 0x01 0x00 0x00 0xc3 0x00 0x00 0x00 0x01 0x00 0x00 0xc4 0x00 0x00 0x00 0x01 0x00 0x00 0xc5 0x00 0x00 0x00 0x01 0x00 0x00 0xc6 0x00 0x00 0x00 0x01 0x00 0x00 0xc7 0x00 0x00 0x00 0x01 0x00 0x00 0xc8 0x00 0x00 0x00 0x01 0x00 0x00 0xc9 0x00 0x00 0x00 0x01 0x00 0x00 0xca 0x00 0x00 0x00 0x01 0x00 0x00 0xcb 0x00 0x00 0x00 0x01 0x00 0x00 0xcc 0x00 0x00 0x00 0x01 0x00 0x00 0xcd 0x00 0x00 0x00 0x01 0x00 0x00 0xce 0x00 0x00 0x00 0x01 0x00 0x00 0xcf 0x00 0x00 0x00 0x01 0x00 0x00 0xd0 0x00 0x00 0x00 0x01 0x00 0x00 0xd1 0x00 0x00 0x00 0x01 0x00 0x00 0xd2 0x00 0x00 0x00 0x01 0x00 0x00 0xd3 0x00 0x00 0x00 0x01 0x00 0x00 0xd4 0x00 0x00 0x00 0x01 0x00 0x00 0xd5 0x00 0x00 0x00 0x01 0x00 0x00 0xd6 0x00 0x00 0x00 0x01 0x00 0x00 0xd7 0x00 0x00 0x00 0x01 0x00 0x00 0xd8 0x00 0x00 0x00 0x01 0x00 0x00 0xd9 0x00 0x00 0x00 0x01 0x00 0x00 0xda 0x00 0x00 0x00 0x01 0x00 0x00 0xdb 0x00 0x00 0x00 0x01 0x00 0x00 0xdc 0x00 0x00 0x00 0x01 0x00 0x00 0xdd 0x00 0x00 0x00 0x01 0x00 0x00>;
		};
	};

	fragment@39 {
		target = <0xffffffff>;

		__overlay__ {
			interrupt-parent = <0xffffffff>;
			interrupts = <0x00 0x08>;
			status = "okay";
		};
	};

	fragment@40 {
		target = <0xffffffff>;

		__overlay__ {
			interrupt-parent = <0xffffffff>;
			interrupts = <0x09 0x02>;
			status = "okay";
		};
	};

	fragment@41 {
		target = <0xffffffff>;

		__overlay__ {
			interrupt-parent = <0xffffffff>;
			interrupts = <0x53 0x01>;
			status = "okay";
		};
	};

	fragment@42 {
		target = <0xffffffff>;

		__overlay__ {
			compatible = "mediatek,md1_sim1_hot_plug_eint-eint";
			interrupts = <0x00 0x04>;
			debounce = <0x00 0x2710>;
			dedicated = <0x00 0x00>;
			src_pin = <0x00 0x01>;
			sockettype = <0x00 0x00>;
			status = "okay";
		};
	};

	fragment@43 {
		target = <0xffffffff>;

		__overlay__ {
			compatible = "mediatek,md1_sim2_hot_plug_eint-eint";
			interrupts = <0x01 0x04>;
			debounce = <0x01 0x2710>;
			dedicated = <0x01 0x00>;
			src_pin = <0x01 0x02>;
			sockettype = <0x01 0x00>;
			status = "okay";
		};
	};

	fragment@44 {
		target = <0xffffffff>;

		__overlay__ {
			mediatek,key-debounce = <0x400>;
			mediatek,sw-pwrkey = <0x74>;
			mediatek,hw-pwrkey = <0x08>;
			mediatek,sw-rstkey = <0x73>;
			mediatek,hw-rstkey = <0x11>;
			mediatek,use-extend-type = <0x00>;
			mediatek,hw-map-num = <0x48>;
			mediatek,hw-init-map = <0x72 0x00 0x00 0x00 0x00 0x00 0x00 0x00 0x00 0x00 0x00 0x00 0x00 0x00 0x00 0x00 0x00 0x00 0x00 0x00 0x00 0x00 0x00 0x00 0x00 0x00 0x00 0x00 0x00 0x00 0x00 0x00 0x00 0x00 0x00 0x00 0x00 0x00 0x00 0x00 0x00 0x00 0x00 0x00 0x00 0x00 0x00 0x00 0x00 0x00 0x00 0x00 0x00 0x00 0x00 0x00 0x00 0x00 0x00 0x00 0x00 0x00 0x00 0x00 0x00 0x00 0x00 0x00 0x00 0x00 0x00 0x00>;
			mediatek,pwrkey-eint-gpio = <0x00>;
			mediatek,pwkey-gpio-din = <0x00>;
			mediatek,hw-dl-key0 = <0x11>;
			mediatek,hw-dl-key1 = <0x00>;
			mediatek,hw-dl-key2 = <0x08>;
			mediatek,hw-recovery-key = <0x11>;
			mediatek,hw-factory-key = <0x00>;
			status = "okay";
		};
	};

	__symbols__ {
		camera_pins_cam0_rst_0 = "/fragment@0/__overlay__/cam0@0";
		camera_pins_cam0_rst_1 = "/fragment@0/__overlay__/cam0@1";
		camera_pins_cam0_pnd_0 = "/fragment@0/__overlay__/pnd0@0";
		camera_pins_cam0_pnd_1 = "/fragment@0/__overlay__/pnd0@1";
		camera_pins_cam1_rst_0 = "/fragment@0/__overlay__/cam1@0";
		camera_pins_cam1_rst_1 = "/fragment@0/__overlay__/cam1@1";
		camera_pins_cam1_pnd_0 = "/fragment@0/__overlay__/pnd1@0";
		camera_pins_cam1_pnd_1 = "/fragment@0/__overlay__/pnd1@1";
		camera_pins_cam0_mclk_off = "/fragment@0/__overlay__/camera_pins_cam0_mclk_off";
		camera_pins_cam0_mclk_2ma = "/fragment@0/__overlay__/camera_pins_cam0_mclk_2ma";
		camera_pins_cam0_mclk_4ma = "/fragment@0/__overlay__/camera_pins_cam0_mclk_4ma";
		camera_pins_cam0_mclk_6ma = "/fragment@0/__overlay__/camera_pins_cam0_mclk_6ma";
		camera_pins_cam0_mclk_8ma = "/fragment@0/__overlay__/camera_pins_cam0_mclk_8ma";
		camera_pins_cam1_mclk_off = "/fragment@0/__overlay__/camera_pins_cam1_mclk_off";
		camera_pins_cam1_mclk_2ma = "/fragment@0/__overlay__/camera_pins_cam1_mclk_2ma";
		camera_pins_cam1_mclk_4ma = "/fragment@0/__overlay__/camera_pins_cam1_mclk_4ma";
		camera_pins_cam1_mclk_6ma = "/fragment@0/__overlay__/camera_pins_cam1_mclk_6ma";
		camera_pins_cam1_mclk_8ma = "/fragment@0/__overlay__/camera_pins_cam1_mclk_8ma";
		camera_pins_cam0_ldo_vcama_0 = "/fragment@0/__overlay__/vcama0@0";
		camera_pins_cam0_ldo_vcama_1 = "/fragment@0/__overlay__/vcama0@1";
		camera_pins_cam0_ldo_vcamd_0 = "/fragment@0/__overlay__/vcamd0@0";
		camera_pins_cam0_ldo_vcamd_1 = "/fragment@0/__overlay__/vcamd0@1";
		camera_pins_cam0_ldo_vcamio_0 = "/fragment@0/__overlay__/vcamio0@0";
		camera_pins_cam0_ldo_vcamio_1 = "/fragment@0/__overlay__/vcamio0@1";
		camera_pins_cam0_ldo_afen_0 = "/fragment@0/__overlay__/afen0@0";
		camera_pins_cam0_ldo_afen_1 = "/fragment@0/__overlay__/afen0@1";
		camera_pins_cam1_ldo_vcama_0 = "/fragment@0/__overlay__/vcama1@0";
		camera_pins_cam1_ldo_vcama_1 = "/fragment@0/__overlay__/vcama1@1";
		camera_pins_cam1_ldo_vcamd_0 = "/fragment@0/__overlay__/vcamd1@0";
		camera_pins_cam1_ldo_vcamd_1 = "/fragment@0/__overlay__/vcamd1@1";
		camera_pins_cam1_ldo_vcamio_0 = "/fragment@0/__overlay__/vcamio1@0";
		camera_pins_cam1_ldo_vcamio_1 = "/fragment@0/__overlay__/vcamio1@1";
		camera_pins_cam1_ldo_afen_0 = "/fragment@0/__overlay__/afen1@0";
		camera_pins_cam1_ldo_afen_1 = "/fragment@0/__overlay__/afen1@1";
		camera_pins_default = "/fragment@0/__overlay__/camdefault";
		mtk_camera_eeprom2 = "/fragment@2/__overlay__/camera_eeprom2@51";
		camera_main_two_mtk = "/fragment@2/__overlay__/camera_main_two@10";
		mtk_camera_eeprom1 = "/fragment@3/__overlay__/camera_eeprom1@51";
		camera_sub_mtk = "/fragment@3/__overlay__/camera_sub@1a";
		mtk_camera_eeprom3 = "/fragment@3/__overlay__/camera_eeprom3@52";
		camera_sub_two_mtk = "/fragment@3/__overlay__/camera_sub_two@10";
		mtk_camera_eeprom0 = "/fragment@4/__overlay__/camera_eeprom0@50";
		camera_main_mtk = "/fragment@4/__overlay__/camera_main@1a";
		camera_main = "/fragment@5/__overlay__/camera_main";
		camera_sub = "/fragment@5/__overlay__/camera_sub";
		camera_main_two = "/fragment@5/__overlay__/camera_main_two";
		mtkfb_pins_lcm_led_en1 = "/fragment@9/__overlay__/lcm_led_en1_gpio";
		mtkfb_pins_lcm_led_en0 = "/fragment@9/__overlay__/lcm_led_en0_gpio";
		mtkfb_pins_lcm_3v3_en1 = "/fragment@9/__overlay__/lcm_3v3_en1_gpio";
		mtkfb_pins_lcm_3v3_en0 = "/fragment@9/__overlay__/lcm_3v3_en0_gpio";
		mtkfb_pins_lcm_rst_out1_gpio = "/fragment@9/__overlay__/lcm_rst_out1_gpio";
		mtkfb_pins_lcm_rst_out0_gpio = "/fragment@9/__overlay__/lcm_rst_out0_gpio";
		mtkfb_pins_lcm_dsi_te = "/fragment@9/__overlay__/lcm_dsi_te";
		mtkfb_pins_lcd_bias_enp1 = "/fragment@9/__overlay__/lcd_bias_enp1_gpio";
		mtkfb_pins_lcd_bias_enp0 = "/fragment@9/__overlay__/lcd_bias_enp0_gpio";
		mtkfb_pins_lcd_bias_enn1 = "/fragment@9/__overlay__/lcd_bias_enn1_gpio";
		mtkfb_pins_lcd_bias_enn0 = "/fragment@9/__overlay__/lcd_bias_enn0_gpio";
		panel_in1 = "/fragment@12/__overlay__/panel1/port/endpoint";
		panel_in2 = "/fragment@12/__overlay__/panel2/port/endpoint";
		panel_in3 = "/fragment@12/__overlay__/panel3/port/endpoint";
		dsi_out = "/fragment@12/__overlay__/ports/port/endpoint";
		gps_pins_default = "/fragment@13/__overlay__/gps_default";
		gps_l1_lna_pins_ol = "/fragment@13/__overlay__/gps_l1_lna@0";
		gps_l1_lna_pins_dsp_ctrl = "/fragment@13/__overlay__/gps_l1_lna@1";
		gps_l1_lna_pins_oh = "/fragment@13/__overlay__/gps_l1_lna@2";
		ctp_novatek_pins_novatek_default = "/fragment@17/__overlay__/ctp_novatek_pins_novatek_default";
		ctp_novatek_pins_novatek_power_on = "/fragment@17/__overlay__/ctp_novatek_pins_novatek_power_on";
		ctp_novatek_pins_novatek_power_off = "/fragment@17/__overlay__/ctp_novatek_pins_novatek_power_off";
		camera_main_af_mtk = "/fragment@18/__overlay__/camera_main_af@72";
		camera_main_two_af_mtk = "/fragment@19/__overlay__/camera_main_two_af@0d";
		camera_main_three_af_mtk = "/fragment@19/__overlay__/camera_main_three_af@0c";
		spk1 = "/fragment@22/__overlay__/speaker_amp@35";
		spk2 = "/fragment@22/__overlay__/speaker_amp@34";
		mt6366_charger_type = "/fragment@24/__overlay__/mt6366-charger-type";
		sgm41512_main = "/fragment@25/__overlay__/sgm41512_main@1a";
		sgm41513_otg_vbus = "/fragment@25/__overlay__/sgm41512_main@1a/usb-otg-vbus";
		sgm41513_sub = "/fragment@26/__overlay__/sgm41513_sub@1a";
	};

	__fixups__ {
		pio = "/fragment@0:target:0\0/fragment@9:target:0\0/fragment@12/__overlay__/panel1:_1v8-gpios:0\0/fragment@12/__overlay__/panel1:_3v3-gpios:0\0/fragment@12/__overlay__/panel1:reset-gpios:0\0/fragment@12/__overlay__/panel1:bias-gpios:0\0/fragment@12/__overlay__/panel1:bias-gpios:12\0/fragment@12/__overlay__/panel2:_1v8-gpios:0\0/fragment@12/__overlay__/panel2:_3v3-gpios:0\0/fragment@12/__overlay__/panel2:reset-gpios:0\0/fragment@12/__overlay__/panel2:bias-gpios:0\0/fragment@12/__overlay__/panel2:bias-gpios:12\0/fragment@12/__overlay__/panel3:_1v8-gpios:0\0/fragment@12/__overlay__/panel3:_3v3-gpios:0\0/fragment@12/__overlay__/panel3:reset-gpios:0\0/fragment@12/__overlay__/panel3:bias-gpios:0\0/fragment@12/__overlay__/panel3:bias-gpios:12\0/fragment@13:target:0\0/fragment@15/__overlay__/himax_touch@48:interrupt-parent:0\0/fragment@15/__overlay__/himax_touch@48:himax,irq-gpio:0\0/fragment@15/__overlay__/himax_touch@48:himax,rst-gpio:0\0/fragment@15/__overlay__/himax_touch@48:himax,3v3-gpio:0\0/fragment@16/__overlay__/spi-himax@0:himax,rst-gpio:0\0/fragment@16/__overlay__/spi-himax@0:himax,irq-gpio:0\0/fragment@16/__overlay__/spi-himax@0:himax,lcm-id0:0\0/fragment@16/__overlay__/spi-himax@0:himax,lcm-id1:0\0/fragment@16/__overlay__/spi-touch@1:novatek,reset-gpio:0\0/fragment@16/__overlay__/spi-touch@1:novatek,irq-gpio:0\0/fragment@17:target:0\0/fragment@22/__overlay__/speaker_amp@35:reset-gpio:0\0/fragment@22/__overlay__/speaker_amp@35:irq-gpio:0\0/fragment@22/__overlay__/speaker_amp@34:reset-gpio:0\0/fragment@22/__overlay__/speaker_amp@34:irq-gpio:0\0/fragment@25/__overlay__/sgm41512_main@1a:sgm,irq-gpio:0\0/fragment@25/__overlay__/sgm41512_main@1a:sgm,chg-en-gpio:0\0/fragment@26/__overlay__/sgm41513_sub@1a:sgm,irq-gpio:0\0/fragment@26/__overlay__/sgm41513_sub@1a:sgm,chg-en-gpio:0\0/fragment@37/__overlay__:GPIO_SIM1_HOT_PLUG:0\0/fragment@37/__overlay__:GPIO_SIM2_HOT_PLUG:0\0/fragment@37/__overlay__:GPIO_SIM1_SCLK:0\0/fragment@37/__overlay__:GPIO_SIM1_SRST:0\0/fragment@37/__overlay__:GPIO_SIM1_SIO:0\0/fragment@37/__overlay__:GPIO_SIM2_SCLK:0\0/fragment@37/__overlay__:GPIO_SIM2_SRST:0\0/fragment@37/__overlay__:GPIO_SIM2_SIO:0\0/fragment@37/__overlay__:GPIO_FDD_BAND_SUPPORT_DETECT_1ST_PIN:0\0/fragment@39/__overlay__:interrupt-parent:0\0/fragment@40/__overlay__:interrupt-parent:0\0/fragment@41/__overlay__:interrupt-parent:0";
		kd_camera_hw1 = "/fragment@1:target:0";
		i2c2 = "/fragment@2:target:0\0/fragment@19:target:0";
		i2c4 = "/fragment@3:target:0";
		i2c8 = "/fragment@4:target:0\0/fragment@18:target:0";
		thermal_zones = "/fragment@5:target:0";
		chosen = "/fragment@6:target:0";
		mtk_leds = "/fragment@7:target:0";
		disp_pwm = "/fragment@7/__overlay__/backlight:pwms:0";
		utos = "/fragment@8:target:0";
		mtkfb = "/fragment@10:target:0";
		dispsys_config = "/fragment@11:target:0";
		dsi0 = "/fragment@12:target:0";
		gps = "/fragment@14:target:0";
		i2c0 = "/fragment@15:target:0";
		spi0 = "/fragment@16:target:0";
		camera_af_hw_node = "/fragment@20:target:0";
		i2c6 = "/fragment@21:target:0";
		i2c3 = "/fragment@22:target:0\0/fragment@26:target:0";
		sound = "/fragment@23:target:0";
		pmic = "/fragment@24:target:0";
		pmic_auxadc = "/fragment@24/__overlay__/mt6366-charger-type:io-channels:0";
		i2c5 = "/fragment@25:target:0";
		extcon_usb = "/fragment@27:target:0";
		charger = "/fragment@28:target:0";
		mtk_gauge = "/fragment@29:target:0";
		pe = "/fragment@30:target:0";
		pe2 = "/fragment@31:target:0";
		pdc = "/fragment@32:target:0";
		rt5133 = "/fragment@33:target:0";
		rt5133_gpio1 = "/fragment@34:target:0";
		rt5133_gpio2 = "/fragment@35:target:0";
		rt5133_gpio3 = "/fragment@36:target:0";
		gpio_usage_mapping = "/fragment@37:target:0";
		gpio = "/fragment@38:target:0";
		mrdump_ext_rst = "/fragment@39:target:0";
		touch = "/fragment@40:target:0";
		dsi_te = "/fragment@41:target:0";
		md1_sim1_hot_plug_eint = "/fragment@42:target:0";
		md1_sim2_hot_plug_eint = "/fragment@43:target:0";
		keypad = "/fragment@44:target:0";
	};

	__local_fixups__ {

		fragment@1 {

			__overlay__ {
				pinctrl-0 = <0x00>;
				pinctrl-1 = <0x00>;
				pinctrl-2 = <0x00>;
				pinctrl-3 = <0x00>;
				pinctrl-4 = <0x00>;
				pinctrl-5 = <0x00>;
				pinctrl-6 = <0x00>;
				pinctrl-7 = <0x00>;
				pinctrl-8 = <0x00>;
				pinctrl-9 = <0x00>;
				pinctrl-10 = <0x00>;
				pinctrl-11 = <0x00>;
				pinctrl-12 = <0x00>;
				pinctrl-13 = <0x00>;
				pinctrl-14 = <0x00>;
				pinctrl-15 = <0x00>;
				pinctrl-16 = <0x00>;
				pinctrl-17 = <0x00>;
				pinctrl-18 = <0x00>;
				pinctrl-19 = <0x00>;
				pinctrl-20 = <0x00>;
				pinctrl-21 = <0x00>;
				pinctrl-22 = <0x00>;
				pinctrl-23 = <0x00>;
				pinctrl-24 = <0x00>;
				pinctrl-25 = <0x00>;
				pinctrl-26 = <0x00>;
				pinctrl-27 = <0x00>;
				pinctrl-28 = <0x00>;
				pinctrl-29 = <0x00>;
				pinctrl-30 = <0x00>;
				pinctrl-31 = <0x00>;
				pinctrl-32 = <0x00>;
				pinctrl-33 = <0x00>;
				pinctrl-34 = <0x00>;
			};
		};

		fragment@5 {

			__overlay__ {

				camera_main {
					thermal-sensors = <0x00>;
				};

				camera_sub {
					thermal-sensors = <0x00>;
				};

				camera_main_two {
					thermal-sensors = <0x00>;
				};
			};
		};

		fragment@10 {

			__overlay__ {
				pinctrl-0 = <0x00>;
				pinctrl-1 = <0x00>;
				pinctrl-2 = <0x00>;
				pinctrl-3 = <0x00>;
				pinctrl-4 = <0x00>;
				pinctrl-5 = <0x00>;
				pinctrl-6 = <0x00>;
				pinctrl-7 = <0x00>;
				pinctrl-8 = <0x00>;
				pinctrl-9 = <0x00>;
				pinctrl-10 = <0x00>;
			};
		};

		fragment@11 {

			__overlay__ {
				pinctrl-0 = <0x00>;
				pinctrl-1 = <0x00>;
				pinctrl-2 = <0x00>;
			};
		};

		fragment@12 {

			__overlay__ {

				panel1 {

					port {

						endpoint {
							remote-endpoint = <0x00>;
						};
					};
				};

				panel2 {

					port {

						endpoint {
							remote-endpoint = <0x00>;
						};
					};
				};

				panel3 {

					port {

						endpoint {
							remote-endpoint = <0x00>;
						};
					};
				};

				ports {

					port {

						endpoint {
							remote-endpoint = <0x00>;
						};
					};
				};
			};
		};

		fragment@14 {

			__overlay__ {
				pinctrl-0 = <0x00>;
				pinctrl-1 = <0x00>;
				pinctrl-2 = <0x00>;
				pinctrl-3 = <0x00>;
			};
		};

		fragment@16 {

			__overlay__ {

				spi-touch@1 {
					pinctrl-0 = <0x00>;
					pinctrl-1 = <0x00>;
					pinctrl-2 = <0x00>;
				};
			};
		};

		fragment@23 {

			__overlay__ {

				mediatek,speaker-codec {
					sound-dai = <0x00 0x04>;
				};
			};
		};

		fragment@27 {

			__overlay__ {
				vbus-supply = <0x00>;
				charger = <0x00>;
			};
		};

		fragment@28 {

			__overlay__ {
				charger = <0x00>;
			};
		};

		fragment@29 {

			__overlay__ {
				charger = <0x00>;
			};
		};
	};
};
